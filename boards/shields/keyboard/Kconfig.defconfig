## boards/shields/keyboard/Kconfig.defconfig
```kconfig
if SHIELD_KEYBOARD

config ZMK_KEYBOARD_NAME
    default "Custom 65"

# PRD §11 step 10: ZMK Studio — require explicit unlock before remapping,
# auto-lock after 5 minutes of Studio inactivity.
config ZMK_STUDIO_LOCKING
    default y

config ZMK_STUDIO_LOCK_IDLE_TIMEOUT_SEC
    default 300

endif # SHIELD_KEYBOARD
```

## dts/bindings/zmk,behavior-disp-cycle.yaml
```yaml
# Copyright (c) 2026 keyboard project
# SPDX-License-Identifier: MIT

description: >
  Display-mode cycle behavior. A short press (< tapping-term-ms) advances to
  the next display mode; a long press (>= tapping-term-ms) resets to mode 0
  (the status screen / mode 1 in PRD numbering).

compatible: "zmk,behavior-disp-cycle"

include: zero_param.yaml

properties:
  tapping-term-ms:
    type: int
    default: 500
    description: Hold threshold in ms; >= this value resets to mode 0 (status).
```

## dts/bindings/zmk,behavior-typing-test.yaml
```yaml
# Copyright (c) 2025 — Custom 65% keyboard project
# SPDX-License-Identifier: MIT
#
# PRD §11 step 9 — Typing-test toggle behavior.
# First press starts the test; second press stops it and raises
# zmk_typing_test_state_changed with WPM / CPM / elapsed / key-count results.

description: >
  Typing-test toggle. First press starts the test; second press stops it
  and raises the typing_test_state_changed event with results.

compatible: "zmk,behavior-typing-test"

include: zero_param.yaml
```
