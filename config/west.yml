## dts/bindings/zmk,behavior-shift-branch.yaml
```yaml
# Copyright (c) 2026 keyboard project
# SPDX-License-Identifier: MIT

description: >
  Picks between two bindings based on whether Shift is currently held —
  identical branching logic to zmk,behavior-mod-morph, but without its
  built-in modifier-masking side effect (which conflicts with macros that
  do their own masking via &shift_mask; see behavior_shift_branch.c).

compatible: "zmk,behavior-shift-branch"

include: zero_param.yaml

properties:
  bindings:
    type: phandle-array
    required: true
  mods:
    type: int
    required: true
```

## dts/bindings/zmk,behavior-shift-mask.yaml
```yaml
# Copyright (c) 2026 keyboard project
# SPDX-License-Identifier: MIT

description: >
  Suppresses Shift (LSFT/RSFT) from the outgoing HID report between press
  and release, without touching real key-press state. Used to wrap Espanso
  trigger text inside a macro so it comes out unshifted even while Shift is
  still physically held (see the uppercase-Greek sym_layer macros).

compatible: "zmk,behavior-shift-mask"

include: zero_param.yaml
```
